## drivers/misc/mediatek/thermal/Kconfig
```kconfig
config MTK_THERMAL_PA_VIA_ATCMD
	bool "Thermal switch for query modem RF temp"
	help
	  Internal switch for thermal management
	  to query modem RF temperature
	  via AT command.
	  (RIL sockets)

config MTK_NO_THERMAL_PROTECT
	bool "Disables Thermal Protect"
	default n
	help
	  Enable this config to remove thermal throttle protect
```
